## esp32_wifi_impl/Kconfig.projbuild
```kconfig
menu "Wangyutang device hub"

config DEVICE_WIFI_SSID
    string "Wi-Fi SSID"
    default ""

config DEVICE_WIFI_PASSWORD
    string "Wi-Fi password"
    default ""

config DEVICE_HUB_BASE_URL
    string "Device hub base URL"
    default "https://www.wangyutang.cn/devices/api"

config DEVICE_HUB_TOKEN
    string "Device hub token"
    default ""

config DEVICE_ID
    string "Device ID"
    default "esp32-s3-walle"

endmenu
```
