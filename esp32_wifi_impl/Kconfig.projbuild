## esp32_wifi_impl/main/Kconfig.projbuild
```kconfig
menu "Wangyutang device hub"

config DEVICE_WIFI_SSID
    string "Wi-Fi SSID"
    default ""

config DEVICE_WIFI_PASSWORD
    string "Wi-Fi password"
    default ""

config DEVICE_WIFI_SSID2
    string "Fallback Wi-Fi SSID (empty to disable)"
    default ""

config DEVICE_WIFI_PASSWORD2
    string "Fallback Wi-Fi password"
    default ""

config DEVICE_HUB_BASE_URL
    string "Device hub base URL"
    default "https://www.wangyutang.cn/devices/api"

config DEVICE_ID
    string "Device ID"
    default "esp32-s3-walle"

config DEVICE_NAME
    string "Device display name"
    default "WALLE ESP32"

config DEVICE_FIRMWARE_VERSION
    string "Firmware version"
    default "esp32-wangyutang-v1"

config LOCAL_AUDIO_BASE_URL
    string "Spark local audio HTTP base URL"
    default "http://192.168.1.16:8080/esp32"
    help
      Local-only diagnostic source for the multi-turn WAV fixtures. The ESP32
      fetches this address directly over the LAN; it never goes through the
      device hub, MQTT, or a public audio URL. Spark should serve the fixture
      directory with tools/serve_local_dialogue_audio.sh.

endmenu

menu "AEC Full-Duplex Voice"

config AEC_SERVER_URI
    string "Cloud WebSocket URI (audio_interact /ws/audio)"
    default "ws://110.40.154.41/ws/audio"

config AEC_AUDIO_TOKEN
    string "X-Audio-Token header (empty = none)"
    default ""

config AEC_AFE_INPUT_FORMAT
    string "AFE input channel format (M=mic R=ref N=unused, physical order)"
    default "MR"
    help
      One char per codec input channel in physical order. BoxAudioCodec with
      input_reference=true gives [mic, ref] -> "MR". Must match the hardware or
      AEC will cancel the wrong signal.

config AEC_SOFTWARE_REF
    bool "Use software AEC reference (no hardware speaker loopback into the ADC)"
    default n

config AEC_LOCAL_BARGEIN
    bool "On-device (level-1) barge-in via AFE VAD"
    default y

config AEC_STREAM_TO_CLOUD
    bool "Start the P4 cloud streaming websocket (/ws/audio) at boot"
    default n
    help
      P4 in the task list -- streaming ASR/TTS -- is explicitly scoped as
      "本阶段之后": P0-P3 (AEC + on-device barge-in) validate entirely on
      pre-recorded WAVs over the LAN and need no cloud audio stream. This was
      on unconditionally regardless of phase.

      Measured cost while idle: the connection to /ws/audio never stabilised,
      cycling connected -> error -> disconnected -> reconnect roughly every
      20-50s for hours, each cycle a fresh TLS-adjacent handshake and buffer
      churn. Over that time free_internal (non-PSRAM) RAM sat at ~2.5KB with a
      largest contiguous block of ~1152 bytes -- so small that HTTPS heartbeat
      never once completed the TLS handshake and fell back to plaintext on
      every single beat, and a five-hour silent hang (no crash, no reboot, no
      serial output -- recoverable only by toggling EN) is consistent with some
      later allocation needing more than that 1152-byte block and never getting
      it.

      Off by default until P4 actually starts. Re-enable then, and budget
      internal RAM for it rather than letting it compete with the AFE, MQTT and
      TLS for the same starved pool.

config AEC_BARGEIN_ONSET_GRACE_MS
    int "Ignore barge-in for the first N ms of a TTS turn (AEC converge)"
    default 1500
    help
      Must clear the AEC's convergence time with margin. E1 measured
      convergence at 0.4-0.5 s, and the previous 500 ms sat exactly on that
      boundary: the filter had barely settled when barge-in became eligible,
      residual echo read as speech, and the robot cut its own utterance off
      after ~576 ms. That also makes E4 unmeasurable -- by the time a human
      speaks there is nothing left playing to interrupt.

      Raising this does not cost barge-in latency; it only delays when an
      interruption becomes possible after the robot starts talking, which is
      what the grace exists for. Per the task list, the response to a false
      barge-in is to adjust the VAD gating, not the AEC.

      900 -> 1500 after E5 at its full 127 s scope cut turn06 and turn08 at
      841 and 821 ms of audio. Those look like they precede a 900 ms grace but
      do not: played counts audio while the grace counts wall clock from
      play_task entry, which also covers the HTTP connect and header parse
      ahead of the first sample. Both were fractionally past the gate, the same
      "fires the moment it becomes eligible" shape as v58 and v62.

      This is the cost of the E4 work: vad_min_speech_ms went 128 -> 48 ms to
      meet the latency budget, and the VAD became correspondingly quicker to
      call residual echo speech. E4 and E5 constrain each other directly, and a
      setting that satisfies both has to be demonstrated at full scope, not on
      one clip.

config AEC_BARGEIN_MIN_RMS
    int "Minimum AFE-output RMS for a barge-in to count"
    default 150
    help
      A level test on the post-AEC signal, which is the dimension the duration
      knobs could not separate.

      This was 40, justified by comparing MEAN RMS over a window: 8.5 for the
      robot alone against 218.6 for a human, "~4.5x clear of both". That is the
      wrong statistic. The gate tests EVERY frame, so what matters is the upper
      tail of the robot-alone distribution, and measured per frame (512 samples,
      32 ms) that tail is nowhere near 8.5:

        robot alone, per-turn peak over 20 turns:
          0 0 0 0 14 16 20 21 22 29 30 30 30 30 32 37 60 67 73 94
        human, peak per 4 s utterance window (15 windows):
          357 462 498 634 722 744 795 841 911 932 1234 1248 1300 1583 1662

      Four of twenty robot-only turns crossed 40 and two of them fired, which
      is E5's false-barge-in rate. The classes separate cleanly between 94 and
      357, so 150 sits 1.6x above the observed robot maximum and 2.4x below the
      observed human minimum -- chosen from distributions rather than from a
      pair of numbers.

      It does not fix everything. One recorded false trigger reached max_rms
      1073, above the human minimum, and no level threshold can separate that:
      for that frame the AEC had failed outright rather than leaked.

      This is what vad_energy_threshold does, and that field is unavailable
      here: it only applies when a neural VAD model is loaded, which needs a
      model partition this board's partition table does not have. One frame's
      RMS needs neither, and costs no latency -- the frame has already been
      computed by the time this runs.

      With this gate holding E5, the VAD can go back to its fast settings for
      E4 instead of trading one criterion against the other.

config AEC_VAD_MODE
    int "AFE vad_mode 0..4 (higher rejects more non-speech)"
    default 3
    help
      WebRTC VAD aggressiveness. 4 is the most willing to call something noise
      rather than speech, which is what E5 needs, and it costs no latency
      because it changes the decision rather than how long the decision takes.

      Was 3. Serial confirmed E5 fails at mode 3 with vad_min_speech_ms=64:
      two real barge-ins with zero external stops, cutting turn04 at 8.1 s and
      turn08 at 6.3 s. E4 needs the duration low (median 127 ms at 48 ms, 193 ms
      at 64 ms), so the duration knob alone has no value that satisfies both
      criteria and the threshold has to move instead.

config AEC_VAD_DELAY_MS
    int "AFE vad_delay_ms (esp-sr default 128)"
    default 128
    help
      esp-sr describes this as "the delay of the first speech frame", to be
      raised "if you find vad cache can not cover all speech". It defaults to
      128 ms and the firmware never set it.

      It is worth a measurement because 128 ms is precisely the residue E4
      cannot otherwise account for: at mode 4 with vad_min_speech_ms=64 the
      total is 232 ms, of which 64 + 16 (one sustained frame) + 24 (the
      measured stop) = 104 ms is known. The last unexplained 128 ms in this
      work was also an unset esp-sr default, so assuming this one is
      irreducible pipeline cost would be a guess.

      Measured at 32 ms and it is WORSE: E4 gave 246 ms and 1307 ms, erratic.
      The hypothesis was wrong. This is a lookback cache for the start of
      speech, not a decision delay -- esp-sr's own wording, "if you find vad
      cache can not cover all speech, please increase this value", says as
      much. Shrinking it makes the VAD miss onsets, so it needs MORE speech
      before it fires and the latency goes up. Back to the 128 ms default; the
      residue in E4's budget is genuine pipeline cost.

config AEC_VAD_MIN_SPEECH_MS
    int "AFE vad_min_speech_ms (floor 32, esp-sr default 128)"
    default 48
    help
      How much speech the AFE must hear before it reports VAD_SPEECH. The
      esp-sr default of 128 ms is most of the latency E4 could not account for.

      This is the knob where E4 and E5 meet, and the three points measured so
      far are:

        128 ms  E5 passes at full 127 s scope, E4 ~330 ms      -- E4 fails
         64 ms  E4 median 193 ms (2 of 6 over), E5 untested at scope
         48 ms  E4 median 127 ms, 7 of 7 under; E5 cuts 5 of 5 turns

      At 48 ms the VAD calls residual echo and room noise speech often enough
      that widening the onset grace does not help: the grace only covers the
      opening, and the v69 cuts land at 1.4-5.4 s, well past a 1500 ms gate.
      64 ms is the remaining candidate and has to be shown at full scope on
      both criteria, not one clip and one metric.

config AEC_BARGEIN_SPEECH_FRAMES
    int "Sustained AFE speech frames to trigger local duck"
    default 1
    help
      Stacked on top of vad_min_speech_ms, so the real speech-confirmation
      time is the sum: 48 + 16 = 64 ms, close to the ~48 ms T3.1 asks for.
      The AFE is already requiring sustained speech, so a second sustained
      check on top of it was mostly duplicating that work at the cost of
      latency. At 64 ms per step E4 read 139/188/199/204/212 ms over six
      samples -- a median inside the 200 ms budget but a third of the samples
      outside it, which is not a pass worth claiming.

config AEC_BARGEIN_EARLY_RATIO_X10
    int "Early barge-in: ch0/ch1 ratio rise over its envelope, x10"
    default 18
    help
      Deliberately lower than the click detector's 4.0x, because the two are
      answering different questions. The click is a full-scale burst and wants
      specificity; speech onset wants sensitivity.

      The arithmetic says 4.0x cannot work for speech. During double-talk
      ch0 = echo + voice while ch1 carries only the echo, so the ratio rises
      from G to G + voice/ref. Clearing 4G would need the interrupting voice to
      arrive at the microphone three times louder than the robot's own echo,
      and a person interrupting is usually comparable to it or quieter. v61
      measured 38 ms once (the click itself tripping it) against 286/301/328 ms
      the rest of the time, with the AFE path carrying those.

      1.8x means the voice needs to be about 80% of the echo level. Raise it if
      E5 starts seeing false barge-ins; that is the trade this knob makes.

config AEC_BARGEIN_EARLY_FRAMES
    int "Consecutive raw-mic frames of external sound for the early barge-in"
    default 9999
    help
      Runs before the AFE, so it costs one feed frame (~16 ms) instead of the
      ~210 ms the AFE takes to report speech through its own VAD. Three frames
      is ~48 ms, which is what T3.1 asks for as the speech-start threshold.

      Safe against the robot's own voice because the test is ch0 against ch1:
      the robot raises both channels together, an external talker raises only
      the microphone. Set to a large number to disable and fall back to the
      AFE VAD path alone.

      DISABLED (9999). tools/aec_bench/early_bargein_sim.py replays the
      detector over the archived E3 capture, which contains both channels with
      a real interruption in it, and swept 7 ratios x 4 frame counts: every
      single combination either fires while the robot alone is talking or never
      fires at all. None detects the voice. The robot's own speech moves the
      ch0/ch1 ratio more -- through nonlinearity, room modes and frame skew --
      than an interrupting voice adds to it, so no threshold separates them on
      this hardware. Kept in the tree because the sim makes the negative result
      reproducible, not because it is expected to work.

      Raised from 3 to 8 because the ratio test is fooled by speaker
      nonlinearity. ch1 taps the amplifier electrically and stays linear, while
      ch0 hears the acoustically distorted version, so a loud passage adds
      harmonic energy to ch0 that ch1 cannot account for and the ratio jumps.
      E5 caught this twice at the same point in turn10 (~23.6 s), which is
      content-driven, not a stray.

      Duration is the discriminator that level cannot be: distortion bursts are
      brief, a person interrupting keeps talking. Eight frames is 128 ms, and
      with the 24 ms measured stop that is ~152 ms end to end, still inside the
      200 ms budget.

config AEC_ENDPOINT_MIN_RMS
    int "AFE-output RMS that still counts as the person talking"
    default 40
    help
      The continuation threshold, deliberately far below AEC_BARGEIN_MIN_RMS.

      Starting an interruption and continuing one are different questions.
      Starting needs the high bar or the robot's own residual triggers it;
      continuing does not, because by then somebody is known to be speaking and
      there is nothing left to falsely trigger.

      Measured: with the same bar for both, a speaker 6 dB quieter had their
      recording end at 2.1s instead of 4.5s -- the level dips below 150 during
      the pauses inside a sentence and end-of-speech fires mid-utterance. 40 is
      the value the barge-in gate itself used before the false-trigger work
      moved it to 150, and it is still well clear of the robot-alone residual
      median of 30.

config AEC_BARGEIN_SILENCE_FRAMES
    int "Sustained AFE silence frames before un-ducking a false trigger"
    default 10
    help
      T3.1 asks for roughly 320 ms of continuous silence to end an
      interruption. The AFE's FETCH chunk -- which is what this counts -- is
      512 samples, i.e. 32 ms at 16 kHz, so 320 ms is 10 frames.

      This was 20 for a long while, on the assumption that a frame was 16 ms.
      It is not; the device reports fetch_chunk=512 and frame_ms=32.0. That
      made the real window 640 ms, twice what T3.1 specifies, while the
      criterion was being recorded as passed. Do not re-derive this from the
      feed chunk (256) -- feed and fetch differ.

      This must not be 1. Natural speech has inter-syllable gaps far longer
      than one frame, so un-ducking on the first non-speech frame makes the
      robot bounce back to full volume in the middle of being interrupted and
      duck again a moment later. The asymmetry with the 4-frame start
      threshold is deliberate: starting should be fast, stopping should be
      reluctant.

config AEC_SPEAKER_VOLUME
    int "AEC-path speaker volume 0..100"
    default 75

config AEC_DUCK_VOLUME_PCT
    int "Ducked volume (percent of normal) on local barge-in"
    default 25

config AEC_CLICK_TRIGGER_RATIO_X10
    int "E4 click detector: ch0/ch1 ratio rise over its envelope, x10"
    default 40
    help
      40 means the ratio peak0/peak_ref must reach 4.0x its running envelope
      (+12 dB) for a frame to count as an external onset rather than the
      robot's own echo. The ratio is the discriminator because the echo path
      gain is roughly fixed: the robot's syllables raise both channels and
      leave the ratio flat, while an external click raises only ch0.

      Exposed as config so the detection path can be proven alive without the
      Raspberry Pi. Lowering it far enough makes the robot's own speech trip
      the detector, which is the only positive control available with no
      external sound source -- a value that never fires passes every negative
      test, including one where the detector is broken. Put it back to 40
      afterwards.

config AEC_ENABLE
    bool "Enable AFE acoustic echo cancellation (off = pass-through, for A/B)"
    default y

config AEC_MIC_PGA_GAIN_DB
    int "ES7210 ch0 (microphone) PGA gain in dB"
    default 30
    help
      Written to REG43 after the input is opened. 3 dB steps below 33 dB.

config AEC_REF_PGA_GAIN_DB
    int "ES7210 ch1 (hardware AEC reference) PGA gain in dB"
    default 0
    help
      Written to REG44 after the input is opened. 0 dB is not an oversight,
      it is measured: ch1 taps the amplifier output electrically rather than
      listening acoustically, so at 0 dB it already peaks 9-10 dB hotter than
      the mic does at 30 dB. Real speech at speaker volume 80 peaks at
      -9 dBFS on this channel, inside the -12..-6 target, and volume 100
      already reaches -3.9 dBFS. Raising this would clip long before it would
      help. Both gains are set explicitly so the value is a decision on
      record rather than whatever esp_codec_dev_open() happened to leave
      behind.

endmenu
```
